## Documentation/devicetree/bindings/watchdog/qcom-wdt.txt
```
Qualcomm Krait Processor Sub-system (KPSS) Watchdog
---------------------------------------------------

Required properties :
compatible : shall contain only one of the following:
			"qcom,kpss-wdt-msm8960" (DEPRECATED)
			"qcom,kpss-wdt-apq8064" (DEPRECATED)
			"qcom,kpss-wdt-ipq8064" (DEPRECATED)
			"qcom,kpss-timer"
			"qcom,scss-timer"

- reg : shall contain base register location and length
- clocks : shall contain the input clock

Optional properties :
- interrupts : shall contain the bark and bite interrupts in that order
- timeout-sec : shall contain the default watchdog timeout in seconds,
                if unset, the default timeout is 30 seconds

Example:
	watchdog@208a038 {
		compatible = "qcom,kpss-timer";
		reg = <0xf9017000 0x1000>;
		interrupts = <0 3 0>, <0 4 0>;
		clocks = <&sleep_clk>;
		timeout-sec = <10>;
	};
```
